## boards/BeeEye/MPsensor/board.yml
```yaml
board:
  name: MPsensor
  full_name: Multi-protocol Sensor
  vendor: BeeEye
  socs:
  - name: nrf54l15
    variants:
    - name: xip
      cpucluster: cpuflpr
```
